AUTOSAR XML (schema 4-2-2)
package /Rover_NoSF_v1_pkg/Rover_NoSF_v1_if
  sender receiver interface sr_Interface
    12 x data, all with category=VALUE, type=Double:
      Sensor_BC: sw-calibration-access=READ-ONLY
      Sensor_BL: sw-calibration-access=READ-ONLY
      Sensor_BR: sw-calibration-access=READ-ONLY
      Sensor_FC: sw-calibration-access=READ-ONLY
      Sensor_FL: sw-calibration-access=READ-ONLY
      Sensor_FR: sw-calibration-access=READ-ONLY
      Drive_Direct: sw-calibration-access=READ-ONLY
      Turn_Direct: sw-calibration-access=READ-ONLY
      TR_Left: sw-calibration-access=READ-WRITE
      TR_Right: sw-calibration-access=READ-WRITE
      Lim_Speed_B: sw-calibration-access=READ-WRITE
      Lim_Speed_F: sw-calibration-access=READ-WRITE
  client server interface cs_Interface
    operation Operation1
