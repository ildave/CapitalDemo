AUTOSAR XML (schema 4-2-2)
package /Rover_NoSF_v1_pkg/Rover_NoSF_v1_imp
  swc implementation Rover_NoSF_v1: programming-language=C, sw-version=1.118.1, used-code-generator=Embedded Coder 6.13 (R2017b) 24-Jul-2017, vendor-id=0, behavior=Rover_NoSF_v1
    code-descriptors:
      code Code
        artifact-descriptors:
          short-label=ATRover_c, category=SWSRC
          short-label=CommandLimits_c, category=SWSRC
          short-label=Input_Conversion_c, category=SWSRC
          short-label=Obstacle_Detection_c, category=SWSRC
          short-label=const_params_c, category=SWSRC
          short-label=look1_binlgpw_c, category=SWSRC
          short-label=ATRover_h, category=SWHDR
          short-label=ATRover_private_h, category=SWHDR
          short-label=ATRover_types_h, category=SWHDR
          short-label=CommandLimits_h, category=SWHDR
          short-label=CommandLimits_private_h, category=SWHDR
          short-label=CommandLimits_types_h, category=SWHDR
          short-label=Input_Conversion_h, category=SWHDR
          short-label=Input_Conversion_private_h, category=SWHDR
          short-label=Input_Conversion_types_h, category=SWHDR
          short-label=Obstacle_Detection_h, category=SWHDR
          short-label=Obstacle_Detection_private_h, category=SWHDR
          short-label=Obstacle_Detection_types_h, category=SWHDR
          short-label=look1_binlgpw_h, category=SWHDR
          short-label=rtwtypes_h, category=SWHDR
    resource consumption RsrcCons_ATRover
