AUTOSAR XML (schema 4-2-2)
standard types defined: Double, float64
package /Rover_NoSF_v1_pkg/Rover_NoSF_v1_dt/Ground
  constant specification DefaultInitValue_Double: value-spec=0
